/*******************************************************************************
 * Copyright (c) 2013-2019 iRidi Ltd. www.iridi.com
 *
 * Все права зарегистрированы. Эта программа и сопровождающие материалы доступны
 * на условиях Eclipse Public License v2.0 и Eclipse Distribution License v1.0,
 * которая сопровождает это распространение. 
 *
 * Текст Eclipse Public License доступен по ссылке
 *    http://www.eclipse.org/legal/epl-v20.html
 * Текст Eclipse Distribution License доступн по ссылке
 *   http://www.eclipse.org/org/documents/edl-v10.php.
 *
 * Участники:
 *    Марат Гилязетдинов, Сергей Королёв  - первая версия
 *******************************************************************************/
//////////////////////////////////////////////////////////////////////////
// Вычисление CRC16
// Тест на AVR вычисление CRC16 10000 раз для 256 байт
// Медленная реализация 14 секунд
// Быстрая реализация 5 секунды
//////////////////////////////////////////////////////////////////////////
#include "IridiumCRC16.h"

// Проверка на использование быстрого алгоритма вычисления CRC16
#if defined(IRIDIUM_ENABLE_FAST_CRC16)

#include "IridiumPlatform.h"

// Таблица CRC16 modbus
#if defined(IRIDIUM_MCU_AVR)
// Таблица располагается в программной памяти
#include <avr/pgmspace.h>
const static u16 g_aModbusCRCTable[1024] PROGMEM =
#else
const static u16 g_aModbusCRCTable[1024] =
#endif   // defined(IRIDIUM_MCU_AVR)
{
   0x0000, 0xc0c1, 0xc181, 0x0140, 0xc301, 0x03c0, 0x0280, 0xc241,
   0xc601, 0x06c0, 0x0780, 0xc741, 0x0500, 0xc5c1, 0xc481, 0x0440,
   0xcc01, 0x0cc0, 0x0d80, 0xcd41, 0x0f00, 0xcfc1, 0xce81, 0x0e40,
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   0x6031, 0x9c30, 0xd830, 0x2431, 0x5030, 0xac31, 0xe831, 0x1430
};

#if defined(IRIDIUM_MCU_AVR)
// Версия для AVR
#define crc_n4(crc, data, table) crc ^= data; \
   crc = pgm_read_word(&table[(crc & 0xff) + 0x300]) ^ \
   pgm_read_word(&table[((crc >> 8) & 0xff) + 0x200]) ^ \
   pgm_read_word(&table[((data >> 16) & 0xff) + 0x100]) ^ \
   pgm_read_word(&table[data >> 24]);

#define  crc_n1(crc, data, table) \
   crc = (crc >> 8) ^ pgm_read_word(&table[(crc & 0xff) ^ data]);

#else
// Версия для других платформ
#define crc_n4(crc, data, table) crc ^= data; \
   crc = table[(crc & 0xff) + 0x300] ^ \
   table[((crc >> 8) & 0xff) + 0x200] ^ \
   table[((data >> 16) & 0xff) + 0x100] ^ \
   table[data >> 24];

#define  crc_n1(crc, data, table) \
   crc = (crc >> 8) ^ table[(crc & 0xff) ^ data];

#endif   // defined(IRIDIUM_MCU_AVR)

/**
   Медленное вычисление CRC-16 (Modbus)
   на входе    :  in_u16Init  - первичное значение
                  in_pBuffer  - указатель на буфер с данными
                  in_stSize   - размер данных в буфере
   на выходе   :  вычисленное значение CRC
   примечание  :  name:    "CRC-16/MODBUS"
                  init:    0xFFFF
                  poly:    0x8005 (0xA001)
                  xor:     0x0000
                  rev:     true
*/
u16 GetCRC16Modbus(u16 in_u16Init, const u8* in_pBuffer, size_t in_stSize)
{
   u16 l_u16CRC = in_u16Init;

   // Расчет до выравнивания
   while(((uintptr_t)in_pBuffer & 3) && in_stSize)
   {
      crc_n1(l_u16CRC, *in_pBuffer++, g_aModbusCRCTable);
      in_stSize--;
   }

   // Расчет блоками по 16 байт
   while(in_stSize >= 16)
   {
      in_stSize -= 16;
      crc_n4(l_u16CRC, ((u32*)in_pBuffer)[0], g_aModbusCRCTable);
      crc_n4(l_u16CRC, ((u32*)in_pBuffer)[1], g_aModbusCRCTable);
      crc_n4(l_u16CRC, ((u32*)in_pBuffer)[2], g_aModbusCRCTable);
      crc_n4(l_u16CRC, ((u32*)in_pBuffer)[3], g_aModbusCRCTable);
      in_pBuffer += 16;
   }

   // Расчет остатка
   while(in_stSize--)
      crc_n1(l_u16CRC, *in_pBuffer++, g_aModbusCRCTable);

   return l_u16CRC;
}

#else    // defined(IRIDIUM_ENABLE_FAST_CRC16)

/**
   Медленное вычисление CRC-16 (Modbus)
   на входе    :  in_u16Init  - первичное значение
                  in_pBuffer  - указатель на буфер с данными
                  in_stSize   - размер данных в буфере
   на выходе   :  вычисленное значение CRC
   примечание  :  name:    "CRC-16/MODBUS"
                  init:    0xFFFF
                  poly:    0x8005 (0xA001)
                  xor:     0x0000
                  rev:     true
*/
u16 GetCRC16Modbus(u16 in_u16Init, const u8* in_pBuffer, size_t in_stSize)
{
   // Обработка данных из буфера
   while(in_stSize--)
   {
      in_u16Init ^= *in_pBuffer++;

      for(u8 i = 0; i < 8; i++)
         in_u16Init = in_u16Init & 0x1 ? (in_u16Init >> 1) ^ 0xA001 : in_u16Init >> 1;
   }
   return in_u16Init;
}

#endif   // defined(IRIDIUM_ENABLE_FAST_CRC16)

